## prj.conf
```kconfig
#enable C++
CONFIG_CPP=y
CONFIG_CPP_EXCEPTIONS=y
CONFIG_GLIBCXX_LIBCPP=y
CONFIG_REQUIRES_FULL_LIBCPP=y

# enable printing floats
CONFIG_CBPRINTF_FP_SUPPORT=y
# enable logging 
# Level: [0,4]: [NONE, ERR, WRN, INF, DBG]
CONFIG_LOG=y
CONFIG_LOG_DEFAULT_LEVEL=3
```

## src/main.cpp
```c
#include <stdio.h>
#include <stdbool.h>    // booleans
#include <zephyr/kernel.h>
#include <autoconf.h>
#include <vector>

int main(void)
{
    std::vector<int> vec(3,0);
    vec.push_back(42);

	printf("Hello World! %s\n", CONFIG_BOARD);
    int i = 0.0;
    while(true){
        printk("%s is working since %i seconds \n", CONFIG_BOARD, i);
        i++;
        k_msleep(1000);
    }
	return 0;
}
```
