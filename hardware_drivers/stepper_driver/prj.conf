## CMakeLists.txt
```
# SPDX-License-Identifier: Apache-2.0

cmake_minimum_required(VERSION 3.20.0)
find_package(Zephyr REQUIRED HINTS $ENV{ZEPHYR_BASE})
project(stepper_driver)

# Include headers
target_include_directories(app PRIVATE include)

# shared libraries
set(COMMON_LIBS 
    src/stepper.cpp
    src/controller.cpp
)

# can be set by running west build ... -DTESTS=ON
option(TESTS "Run tests in test/" OFF)

if(TESTS)
    # build only test_main and needed libraries
    target_sources(app PRIVATE test/test_main.cpp ${COMMON_LIBS})
else()
    # build only main and needed libraries
    target_sources(app PRIVATE src/main.cpp ${COMMON_LIBS})
endif()

unset(TESTS CACHE)
```

## prj.conf
```kconfig
#enable C++
CONFIG_CPP=y
CONFIG_STD_CPP20=y
CONFIG_CPP_EXCEPTIONS=y
CONFIG_GLIBCXX_LIBCPP=y
CONFIG_REQUIRES_FULL_LIBCPP=y

# console
CONFIG_STDOUT_CONSOLE=y
CONFIG_PRINTK=y
CONFIG_CBPRINTF_FP_SUPPORT=y

# GPIO
CONFIG_GPIO=y

# Logging (log level 4 = debug will cause kernel overload)
CONFIG_LOG=y
# CONFIG_LOG_PRINTK=y
CONFIG_LOG_MODE_IMMEDIATE=y
CONFIG_LOG_MODE_MINIMAL=y 
CONFIG_LOG_DEFAULT_LEVEL=3 
```

## boards/esp32s2_saola.overlay
```dts
/*
 * SPDX-License-Identifier: Apache-2.0
 *
 * Copyright (c) 2021 Andrei-Edward Popa
 * Copyright (c) 2022 Espressif Systems (Shanghai) Co., Ltd.
 */

#include <dt-bindings/pinctrl/esp32s2-pinctrl.h>

/ {
	aliases {
		en-dir = &stepper0;
	};

	

	stepper0 {
		compatible = "gpio-leds";
		stepper0: stepper_0 {
			gpios = <&gpio0 4 GPIO_ACTIVE_LOW>,
					<&gpio0 5 GPIO_ACTIVE_LOW>,
					<&gpio0 2 GPIO_ACTIVE_LOW>;
		};
	};

};
```

## src/main.c
```c
/*
 * Copyright (c) 2016 Intel Corporation
 * Copyright (c) 2020 Nordic Semiconductor ASA
 *
 * SPDX-License-Identifier: Apache-2.0
 */

/**
 * @file Sample app to demonstrate PWM.
 */

#include <zephyr/kernel.h>
#include <zephyr/sys/printk.h>
#include <zephyr/device.h>
#include <zephyr/drivers/pwm.h>
#include <zephyr/drivers/gpio.h>

/* GPIOs */
#define EN_DIR_NODE 	DT_ALIAS(en_dir)
// #define DIR_NODE	DT_ALIAS(direction)

static struct gpio_dt_spec enable = GPIO_DT_SPEC_GET_BY_IDX(EN_DIR_NODE, gpios, 0);
static struct gpio_dt_spec direction = GPIO_DT_SPEC_GET_BY_IDX(EN_DIR_NODE, gpios, 1);
static struct gpio_dt_spec step = GPIO_DT_SPEC_GET_BY_IDX(EN_DIR_NODE, gpios, 2);

void gpio_configure(const struct gpio_dt_spec gpio_spec, gpio_flags_t gpio_flag);

/* PWM */
// static const struct pwm_dt_spec pwm_led0 = PWM_DT_SPEC_GET(DT_ALIAS(pwm_led0));

// #define MIN_PERIOD PWM_SEC(1U) / 50U // 50Hz
// #define MAX_PERIOD 31250000 //PWM_SEC(1U)

int main(void)
{
	uint32_t pulse_width;
	int ret;

	// printk("\nPWM-based stepper driver\n");
	printk("Starting GPIO setup\n");

	/* GPIO configuration */
	gpio_configure(enable, GPIO_OUTPUT);
	gpio_configure(direction, GPIO_OUTPUT);
	gpio_configure(step, GPIO_OUTPUT);



	// /* PWM configuration */
	// if (!pwm_is_ready_dt(&pwm_led0)) {
	// 	printk("Error: PWM device %s is not ready\n",
	// 	       pwm_led0.dev->name);
	// 	return 0;
	// }

	// printk("Done calibrating; maximum/minimum periods %u/%lu nsec\n",
	//        MAX_PERIOD, MIN_PERIOD);

	// set initial conditions
	gpio_pin_set_dt(&enable, 0);
	gpio_pin_set_dt(&direction, 0);
	gpio_pin_set_dt(&step, 0);

	// ret = pwm_set_dt(&pwm_led0, MIN_PERIOD, 0);
	// if (ret) {
	// 	printk("Error %d: failed to set pulse width\n", ret);
	// 	return 0;
	// }

	k_sleep(K_MSEC(500));

	// pulse_width = MIN_PERIOD/2;
	// pulse_width = 0;
        
	gpio_pin_set_dt(&enable, 1);
	gpio_pin_set_dt(&direction, 1);

	k_sleep(K_MSEC(500));

	// rotate
	int i=0;
	for(i=0; i<(200*4); i++){
		gpio_pin_set_dt(&step, 1);
		k_sleep(K_USEC(250/4));
		gpio_pin_set_dt(&step, 0);
		k_sleep(K_USEC(250/4));
	}
	// set pulse width
	// ret = pwm_set_dt(&pwm_led0, MIN_PERIOD, pulse_width);
	// if (ret) {
	// 	printk("Error %d: failed to set pulse width\n", ret);
	// 	return 0;
	// }

	// k_sleep(K_MSEC(5000));
	// set pulse width
	// ret = pwm_set_dt(&pwm_led0, MIN_PERIOD, 0);
	// if (ret) {
	// 	printk("Error %d: failed to set pulse width\n", ret);
	// 	return 0;
	// }

	k_sleep(K_MSEC(500));

	gpio_pin_set_dt(&enable, 0);
	gpio_pin_set_dt(&direction, 0);
	
	return 0;
}




void gpio_configure(const struct gpio_dt_spec gpio_spec, gpio_flags_t gpio_flag){
	if (!device_is_ready(gpio_spec.port)) {
		printk("Error: button device %s is not ready\n", gpio_spec.port->name);
		// return -1;
	} else {
        int ret = gpio_pin_configure_dt(&gpio_spec, gpio_flag);
        if (ret != 0) {
            printk("Error %d: failed to configure %s pin %d to %d\n", ret, gpio_spec.port->name, gpio_spec.pin, gpio_spec.dt_flags);
            // return -1;
        } else {
            printk("Configured %s pin %d to %d\n",gpio_spec.port->name, gpio_spec.pin, gpio_spec.dt_flags);
        }
    }
}
```

## src/main.cpp
```c
#include "stepper.h"
#include "controller.h"

int main(void)
{
	// Stepper stepper(4); // using step divider 1/4
	// k_sleep(K_MSEC(20));
	// stepper.enable_stepper();

	// stepper.set_velocity(600.0); // 3 rotations per second
	// k_sleep(K_MSEC(333));		 // one full rotation
	// printk("Steps: %f\n", stepper.get_position());

	// stepper.set_velocity(-600.0); // -3 rotations per second
	// k_sleep(K_MSEC(333));		  // one full rotation
	// printk("Steps: %f\n", stepper.get_position());

	// // deconstructor will disable Stepper

	Controller controller(4, 5000); // kp, sample time (usec)

	// controller.set_velocity(20);
	// k_sleep(K_MSEC(2000));

	controller.set_reference(200);
	k_sleep(K_MSEC(1500));

	controller.dump_buffer();
	k_sleep(K_MSEC(100));

	return 0;
}
```

## include/controller.h
```c
#pragma once
#include <zephyr/kernel.h>
#include <zephyr/sys/printk.h>
#include <zephyr/logging/log.h>
#include <queue>
#include "stepper.h"
#include "math.h"

#define BUFFER_LENGTH 300
#define CONTROL_LOOP_STACK_SIZE 512
#define CONTROL_LOOP_PRIORITY -5 // FIFO thread

class Controller
{

public:
    /*!
     * @brief Constructor
     * @param kp
     * @param sample_time
     */
    explicit Controller(double kp, double sample_time);

    /*!
     * @brief Deconstructor
     * @param none
     */
    virtual ~Controller(void);

    /*!
     * @brief print latest buffer // don't dump while controller is running
     * @param
     */
    void dump_buffer(void);

    /*!
     * @brief set value for velocity control
     * @param vel
     */
    void set_velocity(double vel);

    /*!
     * @brief set value for position control
     * @param ref
     */
    void set_reference(double ref);

private:
    double reference;
    double error;
    double kp;
    double sample_time; // usec

    /* measurement buffer */
    std::queue<double> buffer;

    /* stepper object */
    Stepper stepper;

    /* Timer */
    // struct k_timer control_loop_timer;

    /* Threading */
    struct k_thread control_loop_thread;

    /*!
     * @brief control loop trampoline
     * @param instance pointer
     * @param none
     * @param none
     */
    static void control_loop_thread_entry(void *, void *, void *);

    /*!
     * @brief control loop (running in separate thread)
     * @param none
     */
    void control_loop_thread_function(void);
};
```

## include/stepper.h
```c
#pragma once
#include <zephyr/kernel.h>
#include <zephyr/sys/printk.h>
#include <zephyr/device.h>
#include <zephyr/drivers/gpio.h>
#include <zephyr/logging/log.h>
#include <math.h>

#define STEPPER_STACK_SIZE 512
#define STEPPER_THREAD_PRIORITY -5 // FIFO thread

#define EN_DIR_NODE DT_ALIAS(en_dir)

/* Stepper class */
class Stepper
{

public:
    /*!
     * @brief Constructor
     * @param step_divider (possible values [2, 4, 8, 16])
     */
    explicit Stepper(double step_divider);

    /*!
     * @brief Deconstructor
     * @param none
     */
    virtual ~Stepper(void);

    /*!
     * @brief Enable stepper
     * @param none
     */
    void enable_stepper(void);

    /*!
     * @brief Disable stepper
     * @param none
     */
    void disable_stepper(void);

    /*!
     * @brief Set velocity
     * @param vel in steps/s
     */
    void set_velocity(double vel);

    /*!
     * @brief  measure postion of stepper
     * @param  none
     * @return position in steps
     */
    double get_position(void);

private:
    /* Variables */
    double phi_steps; // angle in steps

    double step_size; // °/step
    double step_divider;

    double current_speed; // steps/s
    double max_speed;     // steps/s

    bool stepper_enabled;

    /* Threading */
    struct k_thread stepper_thread;

    /*!
     * @brief Stepper thread entry (C/C++ trampoline)
     * @param stepper object
     * @param
     * @param
     */
    static void stepper_thread_entry(void *, void *, void *);

    /*!
     * @brief Thread that creates steps based on current_speed
     * @param none
     */
    void stepper_thread_function(void);

    /*!
     * @brief GPIO configuration
     * @param gpio_spec: gpio_dt_spec struct
     * @param gpio_flag: Flags (GPIO_OUTPUT | GPIO_INPUT)
     */
    void gpio_configure(const struct gpio_dt_spec gpio_spec, gpio_flags_t gpio_flag);
};
```

## src/controller.cpp
```c
#include "controller.h"

/* Timer */
K_TIMER_DEFINE(control_loop_timer, NULL, NULL);

/* Threading */
K_THREAD_STACK_DEFINE(control_loop_thread_area, CONTROL_LOOP_STACK_SIZE);

// public
Controller::Controller(double kp, double sample_time) : reference(0),
                                                        error(0),
                                                        kp(kp),
                                                        sample_time(sample_time),
                                                        stepper(4)

{
    // fill buffer with zeros
    for (unsigned i = 0; i < BUFFER_LENGTH; i++)
    {
        buffer.emplace(0);
    }

    // enable stepper
    stepper.enable_stepper();

    // start timer based on sample time
    // k_timer_start(&control_loop_timer, K_NO_WAIT, K_USEC(sample_time));

    // create thread
    k_tid_t control_loop_thread_tid = k_thread_create(&control_loop_thread, control_loop_thread_area,
                                                      K_THREAD_STACK_SIZEOF(control_loop_thread_area),
                                                      Controller::control_loop_thread_entry,
                                                      this, NULL, NULL,
                                                      CONTROL_LOOP_PRIORITY, 0, K_NO_WAIT);
}

Controller::~Controller(void)
{
    // disable stepper
    stepper.disable_stepper();
}

void Controller::dump_buffer(void)
{
    // print conntent of queue
    printk("Latest %d measurements:\n", BUFFER_LENGTH);
    for (unsigned i = 0; i < BUFFER_LENGTH; i++)
    {
        printk("%.3f, ", buffer.front());
        buffer.pop();
    }
    printk("\n");
}

void Controller::set_velocity(double vel)
{
    stepper.set_velocity(vel);
}

void Controller::set_reference(double ref)
{
    reference = ref;
}

// private
void Controller::control_loop_thread_entry(void *instance, void *, void *)
{
    auto thread_instance = reinterpret_cast<Controller *>(instance);
    thread_instance->control_loop_thread_function();
}

void Controller::control_loop_thread_function(void)
{
    while (1)
    {
        // wait for base_timer to expire
        // k_timer_status_sync(&control_loop_timer);;

        // measure stepper angle
        double phi_measured = stepper.get_position();
        buffer.pop();
        buffer.emplace(phi_measured);

        // update output
        error = reference - phi_measured;
        double gain = kp * error;
        stepper.set_velocity(gain);

        k_sleep(K_USEC(sample_time));
    }
}
```

## src/stepper.cpp
```c
#include "stepper.h"

/* Threading */
K_THREAD_STACK_DEFINE(stepper_thread_stack_area, STEPPER_STACK_SIZE);

/* GPIOs */
static struct gpio_dt_spec enable = GPIO_DT_SPEC_GET_BY_IDX(EN_DIR_NODE, gpios, 0);
static struct gpio_dt_spec direction = GPIO_DT_SPEC_GET_BY_IDX(EN_DIR_NODE, gpios, 1);
static struct gpio_dt_spec step = GPIO_DT_SPEC_GET_BY_IDX(EN_DIR_NODE, gpios, 2);

/* Logging*/
LOG_MODULE_REGISTER(logger);

// public:
Stepper::Stepper(double step_divider) : phi_steps(0),
                                        step_size(360.0 / (200.0 * step_divider)),
                                        step_divider(step_divider),
                                        current_speed(0),
                                        max_speed(600* step_divider),
                                        stepper_enabled(false)

{
    // GPIO configuration
    Stepper::gpio_configure(enable, GPIO_OUTPUT);
    Stepper::gpio_configure(direction, GPIO_OUTPUT);
    Stepper::gpio_configure(step, GPIO_OUTPUT);

    // set initial conditions
    gpio_pin_set_dt(&enable, 0);
    gpio_pin_set_dt(&direction, 0);
    gpio_pin_set_dt(&step, 0);

    // create and start thread
    k_tid_t stepper_thread_tid = k_thread_create(&stepper_thread, stepper_thread_stack_area,
                                                 K_THREAD_STACK_SIZEOF(stepper_thread_stack_area),
                                                 Stepper::stepper_thread_entry,
                                                 this, NULL, NULL,
                                                 STEPPER_THREAD_PRIORITY, 0, K_MSEC(10));

    LOG_MODULE_DECLARE(logger);
    LOG_INF("Initialized stepper with step size %.3f° and step divider %0.1f\n", step_size, step_divider);
    LOG_INF("Stepper thread running\n");
}

Stepper::~Stepper(void)
{
    Stepper::disable_stepper();
}

void Stepper::enable_stepper(void)
{
    gpio_pin_set_dt(&enable, 1);
    stepper_enabled = true;
}

void Stepper::disable_stepper(void)
{
    gpio_pin_set_dt(&enable, 0);
    stepper_enabled = false;
}

void Stepper::set_velocity(double vel)
{
    current_speed = vel * step_divider;

    // LOG_MODULE_DECLARE(logger);
    // LOG_INF("Setting speed to %.3f (divider = %.1f)\n", current_speed, step_divider);
}

double Stepper::get_position(void)
{
    return phi_steps / step_divider;
}

// private:
void Stepper::stepper_thread_entry(void *instance, void *, void *)
{
    auto stepper_thead_instance = reinterpret_cast<Stepper *>(instance);
    stepper_thead_instance->stepper_thread_function();
}

void Stepper::stepper_thread_function(void)
{
    while (1)
    {
        double desired_speed = current_speed;

        if (desired_speed != 0 && stepper_enabled)
        {
            if (desired_speed < 0)
            {
                gpio_pin_set_dt(&direction, 1);
            }
            else
            {
                gpio_pin_set_dt(&direction, 0);
            }

            // saturate
            if (fabs(desired_speed) > max_speed)
            {
                desired_speed = max_speed;
            }

            // calculate period in usec
            int period = 1000000.0 / fabs(desired_speed);
            period -= (int)(1277 / step_divider); // correct for time of gpio setting

            // set speed
            gpio_pin_set_dt(&step, 1);
            k_sleep(K_USEC(period / 2));

            gpio_pin_set_dt(&step, 0);
            k_sleep(K_USEC(period / 2));

            // increment/ decrement position
            (desired_speed > 0) ? phi_steps++ : phi_steps--;
        }
        else
        {
            gpio_pin_set_dt(&step, 0);
            k_sleep(K_USEC(10));
        }
    }
}

void Stepper::gpio_configure(const struct gpio_dt_spec gpio_spec, gpio_flags_t gpio_flag)
{
    LOG_MODULE_DECLARE(test);
    if (!device_is_ready(gpio_spec.port))
    {
        LOG_ERR("Error: button device %s is not ready\n", gpio_spec.port->name);
    }
    else
    {
        int ret = gpio_pin_configure_dt(&gpio_spec, gpio_flag);
        if (ret != 0)
        {
            LOG_ERR("Error %d: failed to configure %s pin %d to %d\n", ret, gpio_spec.port->name, gpio_spec.pin, gpio_spec.dt_flags);
        }
        else
        {
            LOG_INF("Configured %s pin %d to %d\n", gpio_spec.port->name, gpio_spec.pin, gpio_spec.dt_flags);
        }
    }
}
```

## src/stepper.h
```c
#pragma once
#include <zephyr/kernel.h>
#include <zephyr/sys/printk.h>
#include <zephyr/device.h>
#include <zephyr/drivers/gpio.h>
#include <zephyr/logging/log.h>
#include <math.h>

#define STEPPER_STACK_SIZE 512
#define STEPPER_THREAD_PRIORITY -5 // FIFO thread

#define EN_DIR_NODE DT_ALIAS(en_dir)

/* Stepper class */
class Stepper
{

public:
    /* Constructor */
    explicit Stepper(double step_divider);

    /* Deconstructor */
    virtual ~Stepper(void);

    /* Enable stepper */
    void enable_stepper(void);

    /* Disable stepper*/
    void disable_stepper(void);

    /* set velocity in steps/s */
    void set_velocity(double vel);
    
    /* get angle in steps */
    double get_position(void);

private:
    /* Variables */
    double phi_steps; // angle in steps

    double step_size; // °/step
    double step_divider;

    double current_speed; // steps/s
    double max_speed;     // steps/s

    /* Threading */
    struct k_thread stepper_thread;

    /* Stepper thread entry */
    static void stepper_thread_entry(void *, void *, void *);

    /* Stepper thread function */
    void stepper_thread_function(void);

    /* GPIO configuration */
    void gpio_configure(const struct gpio_dt_spec gpio_spec, gpio_flags_t gpio_flag);
};
```
