## prj.conf
```kconfig
# enable printing floats
CONFIG_CBPRINTF_FP_SUPPORT=y
# enable logging 
# Level: [0,4]: [NONE, ERR, WRN, INF, DBG]
CONFIG_LOG=y
CONFIG_LOG_DEFAULT_LEVEL=3
CONFIG_LOG_MODE_MINIMAL=y 
```

## src/main.c
```c
#include <stdio.h>
//#include <stdbool.h>    // booleans
#include <zephyr/kernel.h>
#include <autoconf.h>

int main(void)
{
	printf("Hello World! %s\n", CONFIG_BOARD);
    int i = 0;
    while(i<10){
        printk("%s is working since %i seconds \n", CONFIG_BOARD, i);
        i++;
        k_msleep(1000);
    }
	return 0;
}
```
