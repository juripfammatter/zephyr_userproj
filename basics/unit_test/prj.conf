## CMakeLists.txt
```
# SPDX-License-Identifier: Apache-2.0

cmake_minimum_required(VERSION 3.20.0)

find_package(Zephyr REQUIRED HINTS $ENV{ZEPHYR_BASE})
project(unit_test)

# can be set by running west build ... -DTESTS=ON
option(TESTS "Run tests in test/" OFF)
if(TESTS)
    # build only test_main
    target_sources(app PRIVATE test/test_main.cpp)
else()
    # build only main
    target_sources(app PRIVATE src/main.cpp)
endif()
unset(TESTS CACHE)
```

## prj.conf
```kconfig
#enable C++
CONFIG_CPP=y
CONFIG_CPP_EXCEPTIONS=y
CONFIG_GLIBCXX_LIBCPP=y
CONFIG_REQUIRES_FULL_LIBCPP=y

# enable printing floats
CONFIG_CBPRINTF_FP_SUPPORT=y
```

## test.conf
```kconfig
# Additional configuration file 
# can be added to build with
# west build ... DEXTRA_CONF_FILE=test.conf

# enable testing
CONFIG_ZTEST=y
CONFIG_ZTEST_NEW_API=y
```

## src/main.cpp
```c
#include <stdio.h>
#include <stdbool.h>    // booleans
#include <zephyr/kernel.h>
#include <autoconf.h>
#include <vector>

int main(void)
{
    std::vector<int> vec = {0, 1, 2};
    vec.push_back(42);

    for(auto e: vec){
        printk("%i\n", e);
    }
 
	printf("Hello World! %s\n", CONFIG_BOARD);
    int i = 0.0;
    while(true){
        printk("%s is working since %i seconds \n", CONFIG_BOARD, i);
        i++;
        k_msleep(1000);
    }
	return 0;
}
```
