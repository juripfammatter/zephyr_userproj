## basics/unit_test/testcase.yaml
```yaml
tests:
  # section.subsection
  sample.testing.ztest:
    build_only: true
    platform_allow: qemu_xtensa
    integration_platforms:
      - qemu_xtensa
    tags: test_framework
```
