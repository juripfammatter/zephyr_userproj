/*
 * SPDX-License-Identifier: Apache-2.0
 *
 * Copyright (c) 2021 Andrei-Edward Popa
 * Copyright (c) 2022 Espressif Systems (Shanghai) Co., Ltd.
 */

#include <zephyr/dt-bindings/pwm/pwm.h>
#include <dt-bindings/pinctrl/esp32s2-pinctrl.h>

/ {
	aliases {
		led0 = &led0;
	};

	/* create led0 overlay/alias for gpio 26 (ACTIVE_LOW does not seem to have an impact)*/
	leds {
		compatible = "gpio-leds";
		led0: led_0 {
			gpios = <&gpio0 26 GPIO_ACTIVE_LOW>;
		};
	};

};

